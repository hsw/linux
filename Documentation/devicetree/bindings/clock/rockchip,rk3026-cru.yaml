## Documentation/devicetree/bindings/regulator/ti,tps65185.yaml
```yaml
# SPDX-License-Identifier: GPL-2.0-only OR BSD-2-Clause
%YAML 1.2
---
$id: http://devicetree.org/schemas/regulator/ti,tps65185.yaml#
$schema: http://devicetree.org/meta-schemas/core.yaml#

title: TI TPS65185 Power Management Integrated Circuit

maintainers:
  - Andreas Kemnade <andreas@kemnade.info>

description:
  TPS65185 is a Power Management IC to provide Power for EPDs with one 3.3V
  switch, 2 symmetric LDOs behind 2 DC/DC converters, and one unsymmetric
  regulator for a compensation voltage.

properties:
  compatible:
    const: ti,tps65185

  reg:
    maxItems: 1

  enable-gpios:
    description:
      PWRUP pin
    maxItems: 1

  pwr-good-gpios:
    description:
      PGOOD pin. Optional - not every board routes it. When absent the driver
      reads the PG register (0x0F) over I2C instead. Note the register is
      stricter than the pin, which reflects only VDDH/VPOS/VEE/VNEG.
    maxItems: 1

  vcom-ctrl-gpios:
    maxItems: 1

  wakeup-gpios:
    maxItems: 1

  vin-supply: true

  ti,vadj:
    description:
      VADJ VSET[2:0], the VPOS/VNEG level the chip starts with (3 = 15.00 V,
      4 = 14.75 V, 5 = 14.50 V, 6 = 14.25 V). The chip loads VADJ and the
      sequencing registers from its EEPROM whenever WAKEUP rises; the driver
      writes the values given here after that. Absent properties are left as
      the chip has them.
    $ref: /schemas/types.yaml#/definitions/uint32
    minimum: 3
    maximum: 6

  ti,up-sequence:
    description:
      Power-up sequence, the bytes for UPSEQ0 (strobe of each rail) and UPSEQ1
      (delays between the strobes), as in the datasheet.
    $ref: /schemas/types.yaml#/definitions/uint8-array
    minItems: 2
    maxItems: 2

  ti,down-sequence:
    description:
      Power-down sequence, the bytes for DWNSEQ0 (strobe of each rail) and
      DWNSEQ1 (delays between the strobes), as in the datasheet.
    $ref: /schemas/types.yaml#/definitions/uint8-array
    minItems: 2
    maxItems: 2

  interrupts:
    maxItems: 1

  regulators:
    type: object
    additionalProperties: false
    patternProperties:
      "^(vcom|vposneg|v3p3)$":
        unevaluatedProperties: false
        type: object
        $ref: /schemas/regulator/regulator.yaml

required:
  - compatible
  - reg
  - vin-supply

additionalProperties: false

examples:
  - |
    #include <dt-bindings/gpio/gpio.h>
    #include <dt-bindings/interrupt-controller/irq.h>
    i2c {
        #address-cells = <1>;
        #size-cells = <0>;

        pmic@18 {
            compatible = "ti,tps65185";
            reg = <0x18>;
            pinctrl-names = "default";
            pinctrl-0 = <&pinctrl_tps65185_gpio>;
            pwr-good-gpios = <&gpio2 7 GPIO_ACTIVE_HIGH>;
            vcom-ctrl-gpios = <&gpio2 9 GPIO_ACTIVE_HIGH>;
            enable-gpios = <&gpio2 8 GPIO_ACTIVE_HIGH>;
            wakeup-gpios = <&gpio2 5 GPIO_ACTIVE_HIGH>;
            vin-supply = <&epdc_pmic_supply>;
            interrupts-extended = <&gpio2 0 IRQ_TYPE_LEVEL_LOW>;
            ti,up-sequence = /bits/ 8 <0xe4 0x55>;
            ti,down-sequence = /bits/ 8 <0x1e 0xe0>;

            regulators {
                vcom {
                    regulator-name = "vcom";
                };

                vposneg {
                    regulator-name = "vposneg";
                    regulator-min-microvolt = <15000000>;
                    regulator-max-microvolt = <15000000>;
                };

                v3p3 {
                    regulator-name = "v3p3";
                };
            };
        };
    };
```

## Documentation/devicetree/bindings/sound/rockchip,rk3026-codec.yaml
```yaml
# SPDX-License-Identifier: GPL-2.0-only OR BSD-2-Clause
%YAML 1.2
---
$id: http://devicetree.org/schemas/sound/rockchip,rk3026-codec.yaml#
$schema: http://devicetree.org/meta-schemas/core.yaml#

title: Rockchip RK3026 internal audio codec

maintainers:
  - Heiko Stuebner <heiko@sntech.de>

description:
  The RK3026 has an on-die stereo audio codec with a headphone amplifier and
  a mixer, driven over the SoC-internal I2S bus. It is a different block from
  the RK3036/RK3308 "acodec", so it has a compatible and a binding of its own.

allOf:
  - $ref: dai-common.yaml#

properties:
  compatible:
    const: rockchip,rk3026-codec

  reg:
    maxItems: 1

  clocks:
    items:
      - description: clock for the codec, the I2S master clock

  clock-names:
    items:
      - const: mclk

  "#sound-dai-cells":
    const: 0

required:
  - compatible
  - reg
  - clocks
  - clock-names
  - "#sound-dai-cells"

unevaluatedProperties: false

examples:
  - |
    #include <dt-bindings/clock/rk3026-cru.h>
    codec: codec@20030000 {
      compatible = "rockchip,rk3026-codec";
      reg = <0x20030000 0x4000>;
      clocks = <&cru SCLK_I2S>;
      clock-names = "mclk";
      #sound-dai-cells = <0>;
    };
```
