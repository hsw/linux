## Documentation/devicetree/bindings/clock/rockchip,rk3026-cru.yaml
```yaml
# SPDX-License-Identifier: GPL-2.0-only OR BSD-2-Clause
%YAML 1.2
---
$id: http://devicetree.org/schemas/clock/rockchip,rk3026-cru.yaml#
$schema: http://devicetree.org/meta-schemas/core.yaml#

title: Rockchip RK3026 Clock and Reset Unit (CRU)

maintainers:
  - Heiko Stuebner <heiko@sntech.de>

description: |
  The RK3026 clock controller generates and supplies clocks to the controllers
  within the SoC and also implements a reset controller for SoC peripherals.
  Each clock is assigned an identifier and client nodes can use this identifier
  to specify the clock which they consume. All available clocks are defined as
  preprocessor macros in the dt-bindings/clock/rk3026-cru.h header and can be
  used in device tree sources. Similar macros exist for the reset sources in
  the same file.
  The only clock generated outside the SoC that the CRU is fed from is the
  24 MHz crystal:
    - "xin24m" - crystal input - required

properties:
  compatible:
    const: rockchip,rk3026-cru

  reg:
    maxItems: 1

  "#clock-cells":
    const: 1

  "#reset-cells":
    const: 1

  clocks:
    maxItems: 1

  clock-names:
    const: xin24m

  rockchip,grf:
    $ref: /schemas/types.yaml#/definitions/phandle
    description:
      Phandle to the syscon managing the "general register files" (GRF),
      if missing pll rates are not changeable, due to the missing pll
      lock status.

required:
  - compatible
  - reg
  - "#clock-cells"
  - "#reset-cells"
  - clocks
  - clock-names

additionalProperties: false

examples:
  - |
    #include <dt-bindings/clock/rk3026-cru.h>

    cru: clock-controller@20000000 {
      compatible = "rockchip,rk3026-cru";
      reg = <0x20000000 0x1000>;
      clocks = <&xin24m>;
      clock-names = "xin24m";
      rockchip,grf = <&grf>;
      #clock-cells = <1>;
      #reset-cells = <1>;
      assigned-clocks = <&cru PLL_GPLL>;
      assigned-clock-rates = <768000000>;
    };
```

## Documentation/devicetree/bindings/display/rockchip/rockchip,rk3026-ebc.yaml
```yaml
# SPDX-License-Identifier: (GPL-2.0-only OR BSD-2-Clause)
%YAML 1.2
---
$id: http://devicetree.org/schemas/display/rockchip/rockchip,rk3026-ebc.yaml#
$schema: http://devicetree.org/meta-schemas/core.yaml#

title: Rockchip RK3026 E Ink display controller (EBC)

maintainers:
  - Heiko Stuebner <heiko@sntech.de>

description:
  The EBC is the T-CON of the RK3026. It scans an image out of memory and
  drives an 8-bit E Ink source bus, with a 2-bit drive code per pixel and a
  LUT of up to 64 frames per update. The panel's grey levels and its drive
  codes come from a waveform container loaded through the firmware API, one
  LUT per mode and per temperature range, and the panel's own thermometer
  picks the range.

  The waveform belongs to the panel rather than to the controller, so the
  file to load and the thermometer to read are board properties.

properties:
  compatible:
    const: rockchip,rk3026-ebc

  reg:
    maxItems: 1

  interrupts:
    maxItems: 1

  clocks:
    minItems: 4
    maxItems: 5

  clock-names:
    minItems: 4
    maxItems: 5
    items:
      enum: [ hclk, dclk, aclk, mclk, dclk-parent ]

  resets:
    maxItems: 2

  reset-names:
    items:
      - const: axi
      - const: ahb

  rockchip,grf:
    $ref: /schemas/types.yaml#/definitions/phandle
    description:
      The general register file, whose LVDS pad mux routes the shared pads to
      the EBC instead of the LCDC.

  firmware-name:
    description:
      The waveform container for the panel this board carries. The LUTs are
      written for one panel's drive voltages, so a board that carries another
      panel names another container.

  thermal-sensors:
    $ref: /schemas/types.yaml#/definitions/phandle-array
    maxItems: 1
    description:
      The panel's thermometer. Its zone is registered on the sensor's behalf
      and only read here; the phandle names the sensor, and the zone that
      names the same sensor back is the one read.

  epd-supply:
    description: The panel's high-voltage rails, VPOS and VNEG.

  v3p3-supply:
    description: The panel's logic supply, on a board that has one.

  vcom-supply:
    description: The panel's common electrode.

  memory-region:
    maxItems: 1
    description:
      A reusable shared-dma-pool the controller's two 4 bpp images are
      allocated from, hactive * vactive bytes in all. The pool's size must
      cover that, rounded up to the CMA alignment. Without it the default CMA
      area is used.

  rockchip,gdck-sta:
    $ref: /schemas/types.yaml#/definitions/uint32
    description: GDCK start position in the horizontal blanking, in pixels.

  rockchip,lgonl:
    $ref: /schemas/types.yaml#/definitions/uint32
    description: LGONL, the number of lines the panel's source drivers are on.

  panel-timing:
    $ref: /schemas/display/panel/panel-timing.yaml#

  rotation:
    $ref: /schemas/types.yaml#/definitions/uint32
    enum: [ 0, 90, 180, 270 ]
    description: Panel mounting angle, counter-clockwise.

required:
  - compatible
  - reg
  - interrupts
  - clocks
  - clock-names
  - epd-supply
  - vcom-supply
  - rockchip,gdck-sta
  - rockchip,lgonl
  - panel-timing

unevaluatedProperties: false

examples:
  - |
    #include <dt-bindings/clock/rk3026-cru.h>
    #include <dt-bindings/interrupt-controller/arm-gic.h>

    ebc@10114000 {
        compatible = "rockchip,rk3026-ebc";
        reg = <0x10114000 0x4000>;
        interrupts = <GIC_SPI 49 IRQ_TYPE_LEVEL_HIGH>;
        clocks = <&cru HCLK_EBC>, <&cru DCLK_EBC>, <&cru ACLK_LCDC1>,
                 <&cru ACLK_EBC>;
        clock-names = "hclk", "dclk", "aclk", "mclk";
        rockchip,grf = <&grf>;
        epd-supply = <&vposneg>;
        vcom-supply = <&vcom>;
        firmware-name = "rockchip/ed060kd1c2.rkf";
        thermal-sensors = <&tps65185>;
        rockchip,gdck-sta = <100>;
        rockchip,lgonl = <281>;
        rotation = <270>;

        panel-timing {
            clock-frequency = <40000000>;
            hactive = <1448>;
            vactive = <1072>;
            hsync-len = <17>;
            hback-porch = <8>;
            hfront-porch = <55>;
            vsync-len = <2>;
            vback-porch = <4>;
            vfront-porch = <4>;
        };
    };
```

## Documentation/devicetree/bindings/i2c/rockchip,rk3026-i2c.yaml
```yaml
# SPDX-License-Identifier: GPL-2.0-only OR BSD-2-Clause
%YAML 1.2
---
$id: http://devicetree.org/schemas/i2c/rockchip,rk3026-i2c.yaml#
$schema: http://devicetree.org/meta-schemas/core.yaml#

title: Rockchip RK3026 I2C controller

description: |
  The RK3026 has four I2C controllers of the RK3xxx design. Unlike the other
  SoCs of that family the controllers are not wired to a dedicated block: the
  pads and the controller are shared with a legacy DesignWare I2C, and the GRF
  register GRF_SOC_CON1 bit (11 + bus number) selects which of the two drives
  them. The bit resets to the DesignWare block and no bootloader stage sets it,
  so a controller without the GRF handle below never transfers a byte.

maintainers:
  - Heiko Stuebner <heiko@sntech.de>

allOf:
  - $ref: /schemas/i2c/i2c-controller.yaml#

properties:
  compatible:
    const: rockchip,rk3026-i2c

  reg:
    maxItems: 1

  interrupts:
    maxItems: 1

  clocks:
    maxItems: 1

  clock-names:
    const: i2c

  rockchip,grf:
    $ref: /schemas/types.yaml#/definitions/phandle
    description:
      Phandle to the syscon node for the general register file (GRF). The
      driver sets the mode-select bit for the bus in it before the first
      transfer, so it is required.

  clock-frequency:
    default: 100000
    description:
      SCL frequency to use (in Hz). If omitted, 100kHz is used.

  i2c-scl-rising-time-ns:
    default: 1000
    description:
      Number of nanoseconds the SCL signal takes to rise
      (t(r) in I2C specification). If not specified this is assumed to be
      the maximum the specification allows (1000 ns for Standard-mode,
      300 ns for Fast-mode) which might cause slightly slower communication.

  i2c-scl-falling-time-ns:
    default: 300
    description:
      Number of nanoseconds the SCL signal takes to fall
      (t(f) in the I2C specification). If not specified this is assumed to
      be the maximum the specification allows (300 ns) which might cause
      slightly slower communication.

  i2c-sda-falling-time-ns:
    default: 300
    description:
      Number of nanoseconds the SDA signal takes to fall
      (t(f) in the I2C specification). If not specified we will use the SCL
      value since they are the same in nearly all cases.

required:
  - compatible
  - reg
  - interrupts
  - clocks
  - clock-names
  - rockchip,grf

unevaluatedProperties: false

examples:
  - |
    #include <dt-bindings/clock/rk3026-cru.h>
    #include <dt-bindings/interrupt-controller/arm-gic.h>
    #include <dt-bindings/interrupt-controller/irq.h>
    i2c0: i2c@20072000 {
      compatible = "rockchip,rk3026-i2c";
      reg = <0x20072000 0x1000>;
      interrupts = <GIC_SPI 24 IRQ_TYPE_LEVEL_HIGH>;
      clocks = <&cru PCLK_I2C0>;
      clock-names = "i2c";
      rockchip,grf = <&grf>;
      #address-cells = <1>;
      #size-cells = <0>;
    };
```

## Documentation/devicetree/bindings/input/touchscreen/cypress,cyttsp4.yaml
```yaml
# SPDX-License-Identifier: (GPL-2.0-only OR BSD-2-Clause)
%YAML 1.2
---
$id: http://devicetree.org/schemas/input/touchscreen/cypress,cyttsp4.yaml#
$schema: http://devicetree.org/meta-schemas/core.yaml#

title: Cypress TrueTouch Gen4 (CYTTSP4) touchscreen controller

maintainers:
  - Sergei Khomenkov <shomenkow@gmail.com>

description: |
  Cypress TrueTouch Standard Product Generation 4 touchscreen controllers
  (TMA4xx, TMA1036) on I2C. The controller answers on two consecutive I2C
  addresses: the register address is 9 bits wide and its top bit selects
  the second address, so reg is the even (lower) one.

  The panel resolution, the number of contacts and the touch record layout
  are read from the controller's system information registers. The
  touchscreen-* properties give the orientation relative to the
  controller's own axes.

allOf:
  - $ref: touchscreen.yaml#

properties:
  compatible:
    const: cypress,cyttsp4

  reg:
    maxItems: 1

  interrupts:
    maxItems: 1

  reset-gpios:
    maxItems: 1
    description: XRES line of the controller.

  vdd-supply:
    description: Supply of the controller.

  wakeup-source: true

required:
  - compatible
  - reg
  - interrupts

unevaluatedProperties: false

examples:
  - |
    #include <dt-bindings/gpio/gpio.h>
    #include <dt-bindings/interrupt-controller/irq.h>

    i2c {
        #address-cells = <1>;
        #size-cells = <0>;

        touchscreen@24 {
            compatible = "cypress,cyttsp4";
            reg = <0x24>;
            interrupt-parent = <&gpio1>;
            interrupts = <0 IRQ_TYPE_LEVEL_LOW>;
            reset-gpios = <&gpio0 27 GPIO_ACTIVE_LOW>;
            vdd-supply = <&vcc_tp>;
            touchscreen-swapped-x-y;
            touchscreen-inverted-x;
        };
    };
...
```

## Documentation/devicetree/bindings/regulator/active-semi,act8931.yaml
```yaml
# SPDX-License-Identifier: (GPL-2.0-only OR BSD-2-Clause)
%YAML 1.2
---
$id: http://devicetree.org/schemas/regulator/active-semi,act8931.yaml#
$schema: http://devicetree.org/meta-schemas/core.yaml#

title: Active-semi ACT8931 power management unit

maintainers:
  - Sergei Khomenkov <shomenkow@gmail.com>

description: |
  The ACT8931 has three step-down converters (DCDC1-3), four LDOs (LDO1-4)
  and a linear battery charger, controlled over I2C. The DCDC converters
  have two output voltage registers, VSET1 and VSET2; the VSEL pin selects
  which one is in effect. All seven outputs take a 6-bit selector:
  0.6 V + 25 mV steps (0-23), 1.2 V + 50 mV steps (24-47) and 2.4 V +
  100 mV steps (48-63).

properties:
  compatible:
    const: active-semi,act8931

  reg:
    maxItems: 1

  active-semi,vsel-high:
    description:
      Indicates the VSEL pin is high, so the VSET2 registers set the DCDC
      outputs. If this property is missing, the VSEL pin is assumed to be
      low.
    type: boolean

  regulators:
    type: object
    additionalProperties: false
    description:
      The outputs. A minimum equal to the maximum states the voltage the
      board runs the output at.

    patternProperties:
      "^DCDC_REG[1-3]$":
        type: object
        $ref: /schemas/regulator/regulator.yaml#
        unevaluatedProperties: false

      "^LDO_REG[1-4]$":
        type: object
        $ref: /schemas/regulator/regulator.yaml#
        unevaluatedProperties: false

required:
  - compatible
  - reg

additionalProperties: false

examples:
  - |
    i2c {
      #address-cells = <1>;
      #size-cells = <0>;

      pmic@5b {
        compatible = "active-semi,act8931";
        reg = <0x5b>;
        active-semi,vsel-high;

        regulators {
          DCDC_REG1 {
            regulator-min-microvolt = <3400000>;
            regulator-max-microvolt = <3400000>;
          };

          LDO_REG4 {
            regulator-min-microvolt = <3100000>;
            regulator-max-microvolt = <3100000>;
          };
        };
      };
    };
```
